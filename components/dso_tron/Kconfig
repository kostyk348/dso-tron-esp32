## components/dso_tron/Kconfig
```kconfig
menu "DSO-TRON Configuration"

    config DSO_MAX_TASKS
        int "Maximum number of tasks"
        range 4 64
        default 16
        help
            Maximum number of tasks that can be created.

endmenu
```

## sdkconfig.defaults
```kconfig
# DSO-TRON minimal config
CONFIG_IDF_TARGET="esp32"
CONFIG_FREERTOS_UNICORE=n
CONFIG_ESP_DEFAULT_CPU_FREQ_MHZ_240=y
CONFIG_ESP_SYSTEM_EVENT_TASK_STACK_SIZE=0
CONFIG_ESP_MAIN_TASK_STACK_SIZE=0
CONFIG_ESP_MAIN_TASK_AFFINITY_CPU0=y
CONFIG_ESP_CONSOLE_UART_DEFAULT=y
CONFIG_ESP_CONSOLE_UART_NUM=0
CONFIG_ESP_CONSOLE_UART_BAUDRATE=115200

# Disable FreeRTOS — DSO-TRON replaces it
CONFIG_FREERTOS_ENABLE=n

# DSO-TRON settings
CONFIG_DSO_MAX_TASKS=16
```
